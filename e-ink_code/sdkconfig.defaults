## e-ink_code/sdkconfig.defaults
```kconfig
# Bluetooth Configuration
# Enable Bluetooth
CONFIG_BT_ENABLED=y

# Use nimBLE stack (lightweight BLE-only stack)
CONFIG_BT_NIMBLE_ENABLED=y

# Larger stack for NimBLE host task (avoids Instruction access fault / crash on client connect)
CONFIG_BT_NIMBLE_HOST_TASK_STACK_SIZE=8192

# Disable Bluedroid (classic Bluetooth stack)
CONFIG_BT_BLUEDROID_ENABLED=n

# Disable Classic Bluetooth
CONFIG_BT_CLASSIC_ENABLED=n

# Use BLE-only mode
CONFIG_BTDM_CTRL_MODE_BLE_ONLY=y
```
